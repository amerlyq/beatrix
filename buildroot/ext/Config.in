## buildroot/ext/board/qemu-arm-vexpress-2020/defconfig
```kconfig
BR2_DEFCONFIG="$(BTRX_BR2_SET_DIR)/defconfig"
BR2_arm=y
BR2_cortex_a9=y
BR2_ARM_ENABLE_NEON=y
BR2_ARM_ENABLE_VFP=y
BR2_ARM_FPU_NEON=y
BR2_ARM_INSTRUCTIONS_THUMB2=y
BR2_DL_DIR="$(BTRX_CACHE_PREFIX)dl/buildroot"
BR2_CCACHE=y
BR2_CCACHE_DIR="$(BTRX_CACHE_PREFIX)ccache"
BR2_CCACHE_INITIAL_SETUP="--max-size=3G"
BR2_ENABLE_DEBUG=y
BR2_DEBUG_3=y
BR2_OPTIMIZE_G=y
BR2_PACKAGE_OVERRIDE_FILE="$(BR2_EXTERNAL_BTRX_PATH)/local.mk"
BR2_GLOBAL_PATCH_DIR="$(BR2_EXTERNAL_BTRX_PATH)/patches"
BR2_REPRODUCIBLE=y
BR2_SSP_STRONG=y
BR2_FORTIFY_SOURCE_2=y
BR2_TOOLCHAIN_EXTERNAL=y
BR2_TOOLCHAIN_EXTERNAL_GDB_SERVER_COPY=y
BR2_ROOTFS_MERGED_USR=y
BR2_TARGET_GENERIC_ROOT_PASSWD="root"
BR2_SYSTEM_DHCP="eth0"
BR2_SYSTEM_DEFAULT_PATH="/usr/bin:/usr/sbin"
BR2_ROOTFS_OVERLAY="$(BR2_EXTERNAL_BTRX_PATH)/overlay"
BR2_LINUX_KERNEL=y
# BR2_LINUX_KERNEL_USE_ARCH_DEFAULT_CONFIG=y
BR2_LINUX_KERNEL_DEFCONFIG="vexpress"
BR2_LINUX_KERNEL_CONFIG_FRAGMENT_FILES="$(BTRX_BR2_SET_DIR)/kernel.config"
BR2_LINUX_KERNEL_LZO=y
BR2_LINUX_KERNEL_DTS_SUPPORT=y
BR2_LINUX_KERNEL_INTREE_DTS_NAME="vexpress-v2p-ca9"
# BR2_PACKAGE_LINUX_TOOLS_PERF=y
# BR2_PACKAGE_LINUX_TOOLS_PERF_TUI=y
BR2_PACKAGE_BUSYBOX_CONFIG_FRAGMENT_FILES="$(BTRX_BR2_SET_DIR)/busybox.config"
# BR2_PACKAGE_STRACE=y
BR2_PACKAGE_DROPBEAR=y
# BR2_PACKAGE_DROPBEAR_CLIENT is not set
BR2_PACKAGE_DROPBEAR_DISABLE_REVERSEDNS=y
# BR2_PACKAGE_DROPBEAR_SMALL is not set
BR2_TARGET_ROOTFS_CPIO=y
# BR2_TARGET_ROOTFS_TAR is not set
```
